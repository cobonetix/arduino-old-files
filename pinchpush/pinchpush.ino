#include <Ethernet.h>


/*
 * Released: 4/21/20 
 * Version: 1.1.0
 */
 
 /*
 * Released: 4/30/20 
 * Version: 1.2.0
 * fixed bug related to min max limits for servo , added note for increased rotation servo 
 * changed verbs for servo actuation , commands for complex actions , label removal, placement etc. 
 * modified command set to be multiline , easier to keep track 
 * added check in move motor to see if a servo is attached, as that can be called from anywhere in code. 
 * tbd: add detach functions for testing, print out values for min and max limits when user enters values outside limits
 * check size of params array in the for loop
 */

///#define Serial Serial1

void release_version()
{
  Serial.println(F("Version:2.0.1"));
  Serial.println(F("release:11/18/2020"));
}

//Libraries included here
#include <avr/wdt.h>
#include <Servo.h>
#include <avr/pgmspace.h>
#include <SparkFunMPU9250-DMP.h>

MPU9250_DMP imu;


//Pins defined here
//EE Type GPIO PINS

//Servo pins for L12-R/Hitec HS servos
#define SERVO_PINCH 5
#define SERVO_PUSH  6
#define SERVO_GRIP  9
#define LABEL_DETECT 12 // D3 for label drop/ pickup detect

//LED Pins
#define ILLUM_LED_ONE     10
#define ILLUM_LED_TWO     11
#define POWER_CONTROL_PIN  3

//Servo Limits
#define SERVO_DEGREE_LOWER 0
#define SERVO_DEGREE_UPPER 180
#define SERVO_PINCH_PUSH_MICROSEC_LOWER 600 // important, check specs  for a servo before setting these limits // limits ~800 for increased rotation servo
#define SERVO_PINCH_PUSH_MICROSEC_HIGHER 2200 // important, check specs  for a servo before setting these limits // limit ~1700 for increased roation servo
#define SERVO_MICROSECS_LOWER_GRIP 800
#define SERVO_MICROSECS_UPPER_GRIP 2100
#define WAIT_TIMES_LOWER 100
#define WAIT_TIMES_UPPER 5000


//Object Declarations
Servo myservo_pinch;
Servo myservo_push;
Servo myservo_grip;

unsigned char dmpbuffer[100];


//Other #defines or const variables here
//Command defines
#define MAX_CMD_LENGTH    255
#define NUM_COMMANDS 29 // size of myCOmmands array update when updating commands
const char *myCommands[] = 
{
  "inv_cmd", "is_lbl_prsnt1","get_ee_type", "grip_close", 
  "pinch_close", "push_close","pinch_open", "grip_open", 
  "push_open", "set_pinch_open",  "set_pinch_close", "set_grip_open",
  "set_grip_close", "set_push_open",  "set_push_close", "rels_wt_time",
  "spike_wt_time", "get_params", "vers_info", "ctrl_illum", 
  "ctrl_power", "reset", "rmv_lbl", "open_all" ,
  "place_lbl", "pick_lbl", "rls_spikes", "detach_all","orient"
  };

enum {
  INVALID_COMMAND, IS_LABEL_PRESENT1,GET_EE_TYPE, GRIP_CLOSE, 
  PINCH_CLOSE, PUSH_CLOSE, PINCH_OPEN, GRIP_OPEN, 
  PUSH_OPEN, SET_PINCH_OPEN, SET_PINCH_CLOSE, SET_GRIP_OPEN,
  SET_GRIP_CLOSE, SET_PUSH_OPEN, SET_PUSH_CLOSE, RELEASE_WAIT_TIME, 
  SPIKE_WAIT_TIME, GET_PARAMS, VERSION_INFO, CONTROL_ILLUMINATION,
  CONTROL_POWER, RESET,REMOVE_LABEL, OPEN_ALL,
  PLACE_LABEL,PICK_LABEL, RELEASE_SPIKES, DETACH_ALL,ORIENT
  };

//Global variables defined here
//Serial Command Strings
String inputString;
String command;
String parameters;
//String Status
bool cmdComplete;   //whether the serial communication is complete
bool cmdBreak;      //whether the command is being separated
//param flag tracks which part of the input we are on
int paramFlag;
//Servos
bool pinchInit;
bool pushInit;
bool gripInit;
int pinchOpen;
int pinchClose;
int pushOpen;
int pushClose;
int gripOpen;
int gripClose;
int releaseWaitTime;
int spikeWaitTime;
int count = 0;

int gripActuationDelay;
int pushActuationDelay;
int pinchActuationDelay;


float latestRoll  = -1.0;
float latestPitch = -1.0;
float latestYaw   = -1.0;

#define IMU_HISTORY 8
int imuIndex = 0;

float rollHistory[IMU_HISTORY];
float pitchHistory[IMU_HISTORY];
float yawHistory[IMU_HISTORY];

extern void SerialEventxx();

void smoothImu(void)
{
  latestRoll = 0.0;
  latestPitch = 0.0;
  latestYaw = 0.0;
  
  for (int i = 0 ; i < IMU_HISTORY ; i++)
  { 
    latestRoll += rollHistory[i];
    latestPitch += pitchHistory[i];
    latestYaw += yawHistory[i];
  }

  //Serial.println ("inpRoll: " + String(rollHistory[0]) + " " + String(rollHistory[1]) + " " + String(rollHistory[2]));
  //Serial.println ("inpYaw: " + String(yawHistory[0]) + " " + String(yawHistory[1]) + " " + String(yawHistory[2]));
  //Serial.println ("sums: " + String(latestRoll) + " " + String(latestPitch) + " " + String(latestYaw));

  latestRoll = latestRoll/IMU_HISTORY;
  latestPitch = latestPitch/IMU_HISTORY;
  latestYaw = latestYaw/IMU_HISTORY;  
}


//Reset Function
void reboot()
{
  wdt_disable();
  wdt_enable(WDTO_15MS);
  while (1) {}
}

//Setup function



void setup()
{
  //Beginning Seria - SET BAUD RATE
  Serial.begin(9600);
  delay(1000);
//  Serial.println("Starting");
 
  
  //Setup GPIO pins
  pinMode(ILLUM_LED_ONE, OUTPUT);
  
  pinMode(ILLUM_LED_TWO, OUTPUT);
  pinMode(POWER_CONTROL_PIN, OUTPUT);
  pinMode(LABEL_DETECT, INPUT_PULLUP); 
 

  //Driving output low initially. 
  
  digitalWrite(ILLUM_LED_ONE, HIGH);
  digitalWrite(ILLUM_LED_TWO, HIGH);
  
  //Sets Variables to Initial Value
  initialize();

  //Printing Version Info
  release_version();
   
  Serial.println(F("msg:ready1"));
  delay(1000);
   
  // Call imu.begin() to verify communication and initialize
  if (imu.begin() != INV_SUCCESS)
  {
     while (1)
    {
      Serial.println("Unable to communicate with MPU-9250");
      Serial.println("Check connections, and try again.");
      Serial.println();
      delay(5000);
    }
  }

  imu.getdmpmemoryCallback = &getDmpMemory;
  
  imu.dmpBegin(DMP_FEATURE_6X_LP_QUAT | // Enable 6-axis quat
               DMP_FEATURE_GYRO_CAL, // Use gyro calibration
              100); // Set DMP FIFO rate to 5 Hz
              
  // DMP_FEATURE_LP_QUAT can also be used. It uses the 
  // accelerometer in low-power mode to estimate quat's.
  // DMP_FEATURE_LP_QUAT and 6X_LP_QUAT are mutually exclusive


//Signal ready to run
  Serial.println(F("msg:ready"));

 //for (int i = 0 ; i < 100; i++)
 //  Serial.println(dmpbuffer[i],HEX);
}

/*
 * The loop function executes over and over. The loop function in this code is meant to 
 * handle the serial communication of the program. It will accept in and parse input through
 * Serial port looking for commands and parameters and look for the EOL char. When it has a 
 * complete input, it executes the run command function.
 */

 
void loop()
{
  SerialEventxx();
   
  //splits the string into command and parameters
  
  if(cmdBreak) {
    paramFlag = 1;
    cmdBreak = false;
  }

  if (cmdComplete) {
    //Executes the command
    run_command();
    //Resets serial communication variables
    reset_cmd();
  }

 
  // Check for new data in the FIFO
    
  if ( imu.fifoAvailable() )
  {
    // Use dmpUpdateFifo to update the ax, gx, mx, etc. values
    if ( imu.dmpUpdateFifo() == INV_SUCCESS)
    {
      // computeEulerAngles can be used -- after updating the
      // quaternion values -- to estimate roll, pitch, and yaw
      
      imu.computeEulerAngles();

      rollHistory[imuIndex] = imu.roll;
      yawHistory[imuIndex] = imu.yaw;
      pitchHistory[imuIndex] = imu.pitch;
      imuIndex = (imuIndex+1) & (IMU_HISTORY-1); 
      
     // if (imuIndex == 0)
      //  printIMUData();

     }   
  }
}

 
void printIMUData(void)
{  
  smoothImu();

 // Serial.println("LatestR/P/Y: " + String(imu.roll,0) + ", " +  String(imu.pitch,0) + ", " + String(imu.yaw,0));
  Serial.println("AvgR/P/Y: " + String(latestRoll,0) + ", " +  String(latestPitch,0) + ", " + String(latestYaw,0));

}

/*
 * The Serial event function runs after every single event in the serial communication port.
 * The code uses this to handle half of the Serial communication processing for efficiency.
 */
void SerialEventxx()
{
  while (Serial.available()) 
  {
    // get the new byte:
    char inChar = (char)Serial.read();
     
    //Colon is command/param seperation
    if (inChar == ':') 
    {
      cmdBreak = true;
      paramFlag = 2;
    }
    //Newline or Carraige Return signals input is entered
    if ((inChar == '\n') || (inChar == '\r'))
    {
      cmdComplete = true;
      paramFlag = 2;
    }
    //Add characters to strings
    inputString += inChar;
    if(paramFlag == 0) 
    {
      command += inChar;
    }
    else if(paramFlag == 1) 
    {
      parameters += inChar;
    }
  }
}

/*
 * The initialize function returns several variables to their initial state.
 */
void initialize()
{
  reset_cmd();
  //Servos
  pinchInit=false;
  pushInit=false;
  gripInit=false;
  pinchOpen=1950;
  pinchClose=1950;
  
  pushOpen=825;
  pushClose=825;
  
  gripOpen=1000;
  gripClose=2000;
  
  releaseWaitTime=1000;
  spikeWaitTime=100;

  gripActuationDelay = 500;
  pushActuationDelay = 500;
  pinchActuationDelay = 500;
 
}

void reset_cmd()
{
  //Strings initialize to no chars
  inputString = "";
  command = "";
  parameters = "";
  //Command Status
  cmdBreak = false; 
  cmdComplete = false;
  //input string param flag
  paramFlag = 0;
}

void moveMotor(String motor, int pos)
{
  if(motor == "pinch")
  {    
      if(!myservo_pinch.attached())
      {
         myservo_pinch.attach(SERVO_PINCH,SERVO_PINCH_PUSH_MICROSEC_LOWER,SERVO_PINCH_PUSH_MICROSEC_HIGHER);
         pinchInit = true;
      }      
    myservo_pinch.writeMicroseconds(pos);
  }
  else if(motor == "push")
  {    
      if(!myservo_push.attached())
      {
        myservo_push.attach(SERVO_PUSH,SERVO_PINCH_PUSH_MICROSEC_LOWER,SERVO_PINCH_PUSH_MICROSEC_HIGHER);
        pushInit = true;
      }       
    myservo_push.writeMicroseconds(pos);
  }
  else if(motor == "grip")
  {    
      if(!myservo_grip.attached())
      {
        myservo_grip.attach(SERVO_GRIP,SERVO_PINCH_PUSH_MICROSEC_LOWER,SERVO_PINCH_PUSH_MICROSEC_HIGHER);
        gripInit = true;
      }   
    myservo_grip.writeMicroseconds(pos);
  }
  else 
  {
    return;
  }
}

/*
 * Run command compares the input command to the command list and executes based on 
 * matches between what was input and the command list.
 */
int run_command()
{
  int cmd;
  int prm;
  int buf_len = 64;
  bool pinStatus;
  char cmd_buf[buf_len];
  command.toCharArray(cmd_buf, buf_len);
  prm = parameters.toInt();
  for(int i = 0; i < NUM_COMMANDS; i++)
  {
    if(strcmp(myCommands[i], cmd_buf) == 0)
    {
      cmd = i;
      break;
    }
  }
  
  switch(cmd)
  {
    //Invalid or no command
    case INVALID_COMMAND:      
      Serial.println(F("nack:inv_cmd"));
      break;

    //Return End Effector Type
    case GET_EE_TYPE:    
      Serial.println(F("ack:get_ee_type:3:pinch_peeler"));    
      break;
    
    //Closes pinch servo and activates grip spikes
    case REMOVE_LABEL:
      moveMotor("grip", gripClose);
      delay(spikeWaitTime);
      moveMotor("pinch", pinchClose);         
      delay(pinchActuationDelay);                //This wait time requires testing; may not be neccessary; may need to be fine tuned.      
      Serial.println(F("ack:rmv_lbl"));
      break;

    //Closes pinch servo without grip spikes
    case PINCH_CLOSE:
      moveMotor("pinch", pinchClose);
      delay(pinchActuationDelay);
      Serial.println(F("ack:pinch_close"));
      break;

    case PINCH_OPEN:
      moveMotor("pinch", pinchOpen);
      delay(pinchActuationDelay);
      Serial.println(F("ack:pinch_open"));
      break;

     case PICK_LABEL:
      moveMotor("pinch", pinchClose);
      delay(pinchActuationDelay);
      Serial.println(F("ack:pick_lbl"));
      break;

    //Pushes the push servo and nothing else
    case PUSH_CLOSE:
      moveMotor("push", pushClose);
      delay(pushActuationDelay);
      Serial.println(F("ack:push_close"));
      break;

     case PUSH_OPEN:
      moveMotor("push", pushOpen);
      delay(pushActuationDelay);
      Serial.println(F("ack:push_open"));
      break;
      
    case PLACE_LABEL:
      moveMotor("push", pushClose);
      delay(pushActuationDelay);
      Serial.println("ack:place_lbl");
      break;

    //Opens the pinch and the grip spikes to release a label 
    case OPEN_ALL:
      moveMotor("push", pushOpen);
      delay(releaseWaitTime);        // Direct equivalent
      moveMotor("grip", gripOpen);
      moveMotor("pinch", pinchOpen);
      delay(pinchActuationDelay);
      Serial.println("ack:open_all");
      break;

   //Releases just the spikes, does not open the grabber finger
    case GRIP_OPEN:
    case RELEASE_SPIKES:
      moveMotor("grip", gripOpen);
      delay(gripActuationDelay);
      Serial.println("ack:rls_spikes");
      break;

    case GRIP_CLOSE:
      moveMotor("grip", gripClose);
      delay(gripActuationDelay);
      Serial.println("ack:grip_close");
      break;

    //Changes the open position of the pinch servo (5-165 degrees)
    case SET_PINCH_OPEN:                     
      if ( prm < SERVO_PINCH_PUSH_MICROSEC_LOWER || prm > SERVO_PINCH_PUSH_MICROSEC_HIGHER )
      {
        Serial.println(F("err:param_out_of_bounds"));        
      }
      else 
      {
        Serial.print(F("ack:set_pinch_open:"));
        Serial.println(prm);
        pinchOpen=prm;
      }
      break;

    //Changes the close position of the pinch servo (5-165 degrees)
    case SET_PINCH_CLOSE:         
      if ( prm < SERVO_PINCH_PUSH_MICROSEC_LOWER || prm > SERVO_PINCH_PUSH_MICROSEC_HIGHER )
      {
        Serial.print(prm + ":");
        Serial.println(F("err:param_out_of_bounds"));// todo print lower limits
      }
      else {
        Serial.print(F("ack:set_pinch_close:"));
        Serial.println(prm);
        pinchClose=prm;
      }
      break;

    /*
     * The spike motor, changed from the SG90 to the MG90D. Cannot support the MG90D with write(angle) so need to use WriteMicroseconds(time)
     * Hence the change from 0-180 to 1000-2000
     */
    //Changes the open position of the grip servo (1000-2000 microseconds)
    case SET_GRIP_OPEN:
      if((prm<SERVO_MICROSECS_LOWER_GRIP)||(prm>SERVO_MICROSECS_UPPER_GRIP))
      {
         Serial.println(F("err:param_out_of_bounds"));// todo print lower limits
      }
      else {
        Serial.print("ack:set_grip_open:");
        Serial.println(prm);
        gripOpen=prm;
      }
      break;

    //Changes the close position of the grip servo (1000-2000 microseconds)
    case SET_GRIP_CLOSE:
      if((prm<SERVO_MICROSECS_LOWER_GRIP)||(prm>SERVO_MICROSECS_UPPER_GRIP))
      {
        Serial.println(F("err:param_out_of_bounds"));// todo print lower limits
      }
      else {
        Serial.print("ack:set_grip_close:");
        Serial.println(prm);
        gripClose=prm;
      }
      break;

    //Changes the open position of the push servo (5-165 degrees)
    case SET_PUSH_OPEN:      
      if ( prm < SERVO_PINCH_PUSH_MICROSEC_LOWER || prm > SERVO_PINCH_PUSH_MICROSEC_HIGHER )
      {        
        Serial.println(F("err:param_out_of_bounds"));// todo print lower limits
      }
      else {
        Serial.print("ack:set_push_open:");
        Serial.println(prm);
        pushOpen=prm;
      }
      break;

    //Changes the close position of the push servo (0-180 degrees)
    case SET_PUSH_CLOSE:     
      if ( prm < SERVO_PINCH_PUSH_MICROSEC_LOWER || prm > SERVO_PINCH_PUSH_MICROSEC_HIGHER )
      {
        
        Serial.println(F("err:param_out_of_bounds")); // todo print  limits
      }
      else {
        Serial.print("ack:set_push_close:");
        Serial.println(prm);
        pushClose=prm;
      }
      break;

    case RELEASE_WAIT_TIME:
      if((prm<WAIT_TIMES_LOWER)||(prm>WAIT_TIMES_UPPER))
      {
        
        Serial.println(F("err:param_out_of_bounds"));
      }
      else 
      {
        Serial.print(F("ack:set_change_release_wait_time:"));
        Serial.println(prm);
        releaseWaitTime=prm;
      }
      break;

    case SPIKE_WAIT_TIME:
      if((prm<WAIT_TIMES_LOWER)||(prm>WAIT_TIMES_LOWER))
      {
        Serial.println(F("err:param_out_of_bounds"));
      }
      else 
      {
        Serial.print(F("ack:set_change_spike_wait_time:"));
        Serial.println(prm);
        spikeWaitTime=prm;
      }
      break;

    /*
     * Change Added 4/21/20 to return the current values of params that can be changed by the user
     */
    case GET_PARAMS:
      Serial.println(F("ack:get_params"));
      Serial.print(F("pinch_open:")); 
      Serial.println(pinchOpen);
      Serial.print(F("pinch_close:")); 
      Serial.println(pinchClose);
      Serial.print(F("push_open:")); 
      Serial.println(pushOpen);
      Serial.print(F("push_close:")); 
      Serial.println(pushClose);
      Serial.print(F("grip_open:")); 
      Serial.println(gripOpen);
      Serial.print(F("grip_close:")); 
      Serial.println(gripClose);
      Serial.print(F("wait_for_release:")); 
      Serial.println(releaseWaitTime);
      Serial.print(F("wait_for_spikes:")); 
      Serial.println(spikeWaitTime);
      break;

    case VERSION_INFO:
      Serial.println(F("ack:version_info"));
      release_version();
      break;

    /*
     * Turns on the lights for the LEDs based on which is specified in the input params
     * These LEDS are right now visable light LEDs but long term these will likely be IR
     * LEDS to provide light for a camera. When that implementation happens, code may change
     * Format.
     * two GPIO's are controlling LED's for the calibration camera illumination and the lower camera illumination
     */
    case CONTROL_ILLUMINATION:      
      switch(prm)
      {
        case 0:
              // stop  illumination
          digitalWrite(ILLUM_LED_ONE, HIGH);
          digitalWrite(ILLUM_LED_TWO, HIGH); 
          Serial.println(F("ack:ctrl_illum:0"));  
        break;  

        case 1:
          digitalWrite(ILLUM_LED_ONE, LOW);
          Serial.println(F("ack:ctrl_illum:1"));  
        break;

        case 2:
          digitalWrite(ILLUM_LED_ONE, HIGH);
          Serial.println(F("ack:ctrl_illum:2"));  
         break;

        case 3:
          digitalWrite(ILLUM_LED_TWO, LOW);
          Serial.println(F("ack:ctrl_illum:3"));
        break;

        case 4:
          digitalWrite(ILLUM_LED_TWO, HIGH);
          Serial.println(F("ack:ctrl_illum:4"));
        break;

        case 5:
          digitalWrite(ILLUM_LED_ONE, LOW);
          digitalWrite(ILLUM_LED_TWO, LOW); 
          Serial.println(F("ack:ctrl_illum:5"));
        break;

       default:
          Serial.println(F("nack:ctrl_illum:" ));
         break;
      }          
      break;

     case CONTROL_POWER:
      switch(prm)
      {
        case 0:
        digitalWrite(POWER_CONTROL_PIN, LOW);
        Serial.println(F("ack:ctrl_power:0"));
        break;

        case 1:
        digitalWrite(POWER_CONTROL_PIN, HIGH);
        Serial.println(F("ack:ctrl_power:1"));
        break;

        default:   
        Serial.println(F("nack:ctrl_power:") );
        break;
        
      }      
      break;
  
    
    //Reset all variables to initial state
    case RESET:
      if(prm==0){
        initialize();
        reset_cmd();
        Serial.println(F("ack:reset:soft"));
      }
      else if(prm==1){
        Serial.println(F("ack:reset:hard"));
        delay(1000);
        reboot;        
      }
      else{
        initialize();
        reset_cmd();
        Serial.println(F("ack:reset"));
        Serial.println(F("msg:default_reset:soft"));
      }
      break;
     
     case DETACH_ALL:
       myservo_grip.detach();
       myservo_push.detach();
       myservo_pinch.detach();
       Serial.println(F("ack:detach_all"));
       break;

     case ORIENT:
       smoothImu();
       Serial.println("ack:orient:" + String("r:") +String(latestRoll,0) + String(":p:") +  String(latestPitch,0) + String(":y:") + String(latestYaw,0));
       break;

      
      case IS_LABEL_PRESENT1:
       pinStatus = false;
       pinStatus = digitalRead(LABEL_DETECT);
       if(pinStatus == true) // weakly pulled up
       {
        // label is   present 
        Serial.println(F("ack:is_lbl_prsnt1:true"));       
       }
       else //  pulled down by gnd
       {
         // label is  not present contact closed
        Serial.println(F("ack:is_lbl_prsnt1:false")); 
       }
       break;
      
     
      
    //No command match
    default:
      Serial.print(cmd);
      Serial.println(F("nack:no_cmd_match"));
      break;
  }
}





#define DMP_CODE_SIZE           (3062)
 
static const unsigned char  dmp_memory  [DMP_CODE_SIZE] PROGMEM= {
    /* bank # 0 */
    0x00, 0x00, 0x70, 0x00, 0x00, 0x00, 0x00, 0x24, 0x00, 0x00, 0x00, 0x02, 0x00, 0x03, 0x00, 0x00,
    0x00, 0x65, 0x00, 0x54, 0xff, 0xef, 0x00, 0x00, 0xfa, 0x80, 0x00, 0x0b, 0x12, 0x82, 0x00, 0x01,
    0x03, 0x0c, 0x30, 0xc3, 0x0e, 0x8c, 0x8c, 0xe9, 0x14, 0xd5, 0x40, 0x02, 0x13, 0x71, 0x0f, 0x8e,
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    0x3b, 0xb6, 0x7a, 0xe8, 0x00, 0x64, 0x00, 0x00, 0x00, 0xc8, 0x00, 0x00, 0x00, 0x00, 0x00, 0x00,
    /* bank # 1 */
    0x10, 0x00, 0x00, 0x00, 0x10, 0x00, 0xfa, 0x92, 0x10, 0x00, 0x22, 0x5e, 0x00, 0x0d, 0x22, 0x9f,
    0x00, 0x01, 0x00, 0x00, 0x00, 0x32, 0x00, 0x00, 0xff, 0x46, 0x00, 0x00, 0x63, 0xd4, 0x00, 0x00,
    0x10, 0x00, 0x00, 0x00, 0x04, 0xd6, 0x00, 0x00, 0x04, 0xcc, 0x00, 0x00, 0x04, 0xcc, 0x00, 0x00,
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    0x00, 0x00, 0x10, 0x00, 0x00, 0x2f, 0x00, 0x00, 0x00, 0x00, 0x01, 0xf4, 0x00, 0x00, 0x10, 0x00,
    /* bank # 2 */
    0x00, 0x28, 0x00, 0x00, 0xff, 0xff, 0x45, 0x81, 0xff, 0xff, 0xfa, 0x72, 0x00, 0x00, 0x00, 0x00,
    0x00, 0x00, 0x00, 0x00, 0x00, 0x44, 0x00, 0x05, 0x00, 0x05, 0xba, 0xc6, 0x00, 0x47, 0x78, 0xa2,
    0x00, 0x00, 0x00, 0x01, 0x00, 0x00, 0x00, 0x00, 0x00, 0x00, 0x06, 0x00, 0x00, 0x00, 0x00, 0x14,
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    0xff, 0xe5, 0x00, 0x00, 0x00, 0x00, 0x00, 0x00, 0x00, 0x00, 0x00, 0x00, 0x00, 0x00, 0x00, 0x00,
    /* bank # 3 */
    0x00, 0x00, 0x00, 0x01, 0x00, 0x00, 0x00, 0x00, 0x00, 0x01, 0x00, 0x00, 0x00, 0x00, 0x00, 0x00,
    0x00, 0x01, 0x80, 0x00, 0x00, 0x01, 0x80, 0x00, 0x00, 0x01, 0x80, 0x00, 0x00, 0x24, 0x26, 0xd3,
    0x00, 0x00, 0x00, 0x00, 0x00, 0x00, 0x00, 0x00, 0x00, 0x06, 0x00, 0x10, 0x00, 0x96, 0x00, 0x3c,
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    0x00, 0x00, 0x00, 0x00, 0x00, 0x00, 0x00, 0x00, 0x00, 0x00, 0x00, 0x00, 0x00, 0x00, 0x00, 0x00,

    /* bank # 4 */
    0xd8, 0xdc, 0xb4, 0xb8, 0xb0, 0xd8, 0xb9, 0xab, 0xf3, 0xf8, 0xfa, 0xb3, 0xb7, 0xbb, 0x8e, 0x9e,
    0xae, 0xf1, 0x32, 0xf5, 0x1b, 0xf1, 0xb4, 0xb8, 0xb0, 0x80, 0x97, 0xf1, 0xa9, 0xdf, 0xdf, 0xdf,
    0xaa, 0xdf, 0xdf, 0xdf, 0xf2, 0xaa, 0xc5, 0xcd, 0xc7, 0xa9, 0x0c, 0xc9, 0x2c, 0x97, 0xf1, 0xa9,
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    0x7d, 0x98, 0xa8, 0x0e, 0x16, 0x1e, 0xa2, 0x2c, 0x54, 0x7c, 0x92, 0xa4, 0xf0, 0x2c, 0x50, 0x78,
    /* bank # 5 */
    0xf1, 0x84, 0xa8, 0x98, 0xc4, 0xcd, 0xfc, 0xd8, 0x0d, 0xdb, 0xa8, 0xfc, 0x2d, 0xf3, 0xd9, 0xba,
    0xa6, 0xf8, 0xda, 0xba, 0xa6, 0xde, 0xd8, 0xba, 0xb2, 0xb6, 0x86, 0x96, 0xa6, 0xd0, 0xf3, 0xc8,
    0x41, 0xda, 0xa6, 0xc8, 0xf8, 0xd8, 0xb0, 0xb4, 0xb8, 0x82, 0xa8, 0x92, 0xf5, 0x2c, 0x54, 0x88,
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    0x21, 0xd1, 0xda, 0xa5, 0xf9, 0xf4, 0x17, 0xd9, 0xf1, 0xae, 0x8e, 0xd0, 0xc0, 0xc3, 0xae, 0x82,
    /* bank # 6 */
    0xc6, 0x84, 0xc3, 0xa8, 0x85, 0x95, 0xc8, 0xa5, 0x88, 0xf2, 0xc0, 0xf1, 0xf4, 0x01, 0x0e, 0xf1,
    0x8e, 0x9e, 0xa8, 0xc6, 0x3e, 0x56, 0xf5, 0x54, 0xf1, 0x88, 0x72, 0xf4, 0x01, 0x15, 0xf1, 0x98,
    0x45, 0x85, 0x6e, 0xf5, 0x8e, 0x9e, 0x04, 0x88, 0xf1, 0x42, 0x98, 0x5a, 0x8e, 0x9e, 0x06, 0x88,
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    0xf8, 0xd8, 0xb0, 0xb4, 0xb8, 0xd8, 0xad, 0x84, 0xf2, 0xc0, 0xdf, 0xf1, 0x8f, 0xcb, 0xc3, 0xa8,
    /* bank # 7 */
    0xb2, 0xb6, 0x86, 0x96, 0xc8, 0xc1, 0xcb, 0xc3, 0xf3, 0xb0, 0xb4, 0x88, 0x98, 0xa8, 0x21, 0xdb,
    0x71, 0x8d, 0x9d, 0x71, 0x85, 0x95, 0x21, 0xd9, 0xad, 0xf2, 0xfa, 0xd8, 0x85, 0x97, 0xa8, 0x28,
    0xd9, 0xf4, 0x08, 0xd8, 0xf2, 0x8d, 0x29, 0xda, 0xf4, 0x05, 0xd9, 0xf2, 0x85, 0xa4, 0xc2, 0xf2,
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    0xde, 0xd9, 0xd0, 0xf8, 0xf8, 0xf8, 0xdb, 0x55, 0xf8, 0xd8, 0xa8, 0x78, 0xda, 0xa0, 0xd0, 0xdf,
    /* bank # 8 */
    0xd9, 0xd0, 0xfa, 0xf8, 0xf8, 0xf8, 0xf8, 0xdb, 0x7d, 0xf8, 0xd8, 0x9c, 0xa8, 0x8c, 0xf5, 0x30,
    0xdb, 0x38, 0xd9, 0xd0, 0xde, 0xdf, 0xa0, 0xd0, 0xde, 0xdf, 0xd8, 0xa8, 0x48, 0xdb, 0x58, 0xd9,
    0xdf, 0xd0, 0xde, 0xa0, 0xdf, 0xd0, 0xde, 0xd8, 0xa8, 0x68, 0xdb, 0x70, 0xd9, 0xdf, 0xdf, 0xa0,
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    0xd8, 0xa1, 0x81, 0x94, 0xf8, 0x18, 0xf2, 0xb0, 0x89, 0xac, 0xc3, 0xc5, 0xc7, 0xf1, 0xd8, 0xb8,
    /* bank # 9 */
    0xb4, 0xb0, 0x97, 0x86, 0xa8, 0x31, 0x9b, 0x06, 0x99, 0x07, 0xab, 0x97, 0x28, 0x88, 0x9b, 0xf0,
    0x0c, 0x20, 0x14, 0x40, 0xb0, 0xb4, 0xb8, 0xf0, 0xa8, 0x8a, 0x9a, 0x28, 0x50, 0x78, 0xb7, 0x9b,
    0xa8, 0x29, 0x51, 0x79, 0x24, 0x70, 0x59, 0x44, 0x69, 0x38, 0x64, 0x48, 0x31, 0xf1, 0xbb, 0xab,
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    0xc8, 0xf8, 0xf9, 0xd9, 0xde, 0xd8, 0x93, 0x85, 0xf1, 0x4a, 0xb1, 0x83, 0xa3, 0x08, 0xb5, 0x83,
    /* bank # 10 */
    0x9a, 0x08, 0x10, 0xb7, 0x9f, 0x10, 0xd8, 0xf1, 0xb0, 0xba, 0xae, 0xb0, 0x8a, 0xc2, 0xb2, 0xb6,
    0x8e, 0x9e, 0xf1, 0xfb, 0xd9, 0xf4, 0x1d, 0xd8, 0xf9, 0xd9, 0x0c, 0xf1, 0xd8, 0xf8, 0xf8, 0xad,
    0x61, 0xd9, 0xae, 0xfb, 0xd8, 0xf4, 0x0c, 0xf1, 0xd8, 0xf8, 0xf8, 0xad, 0x19, 0xd9, 0xae, 0xfb,
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    0x2c, 0x87, 0x0c, 0xa7, 0x81, 0x97, 0x62, 0x93, 0xf0, 0x71, 0x71, 0x60, 0x85, 0x94, 0x01, 0x29,
    /* bank # 11 */
    0x51, 0x79, 0x90, 0xa5, 0xf1, 0x28, 0x4c, 0x6c, 0x87, 0x0c, 0x95, 0x18, 0x85, 0x78, 0xa3, 0x83,
    0x90, 0x28, 0x4c, 0x6c, 0x88, 0x6c, 0xd8, 0xf3, 0xa2, 0x82, 0x00, 0xf2, 0x10, 0xa8, 0x92, 0x19,
    0x80, 0xa2, 0xf2, 0xd9, 0x26, 0xd8, 0xf1, 0x88, 0xa8, 0x4d, 0xd9, 0x48, 0xd8, 0x96, 0xa8, 0x39,
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    0xa6, 0xd9, 0x00, 0xd8, 0xf1, 0xff};
 
int memoryIndex = 0;

void getDmpMemory(int blen, unsigned char *p){
   
   memcpy_PF  ( p,&dmp_memory[memoryIndex],blen);
   memoryIndex += blen;
 }
